## drivers/huawei/Kconfig
```kconfig
menu "huawei linux device driver support package"

#ifdef CONFIG_HUAWEI_GPIO_UNITE
source "drivers/huawei/gpio/Kconfig"
#endif
#ifdef CONFIG_HW_POWER_TREE
source "drivers/huawei/power_config/Kconfig"
#endif
#ifdef CONFIG_HUAWEI_SUSPEND_GPIO
source "drivers/huawei/gpio/Kconfig"
#endif

source "drivers/huawei/log_module/Kconfig"

endmenu
```
